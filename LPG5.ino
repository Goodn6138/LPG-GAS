#include <Adafruit_SSD1306.h>
#include <Adafruit_GFX.h>
#include <ESP8266WiFi.h>
#include <ESP8266HTTPClient.h>
#include <WiFiClient.h>
#include <base64.h>
#include <base64.H>
#include <Wire.h>
#include "HX710.h"

const char* ssid = "HKCC";
const char* pass = "hakricom";
const char* twilioAccountSID = ;
const char* twilioAuthToken = ;


//SETTING UP PRESSURE SENSOR , GAS SENSOR , BUZZER & VIBRATION SENSOR
HX710 ps;
const int DOUT = 14;
const int PD_SCK = 12;
int atm_pressure  = 0 ;
const int LOW_PRESSURE_THRESHOLD = 5;

#define BUZZER 23
#define GAS_SENSOR A0
#define VIBRATION_SENSOR 13


//SETTING UP SCREEEN
#define SCREEN_WIDTH 128
#define SCREEN_HEIGHT 64
#define OLED_RESET -1

#define SCREEN_ADDRESS 0X3C

Adafruit_SSD1306 display(SCREEN_WIDTH, SCREEN_HEIGHT , &Wire, OLED_RESET);

const unsigned char METER [] PROGMEM ={
	0x00, 0x00, 0x00, 0x00, 0x00, 0x00, 0x00, 0x00, 0x00, 0x00, 0x00, 0x00, 0x00, 0x00, 0x00, 0x00, 
	0x00, 0x00, 0x00, 0x00, 0x00, 0x00, 0x00, 0x00, 0x00, 0x00, 0x00, 0x00, 0x00, 0x00, 0x00, 0x00, 
	0x00, 0x00, 0x00, 0x00, 0x00, 0x00, 0x00, 0x00, 0x00, 0x00, 0x00, 0x00, 0x00, 0x00, 0x00, 0x00, 
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	0x00, 0x00, 0x00, 0x00, 0x00, 0x00, 0x00, 0x00
};
const unsigned char LEAK [] PROGMEM ={
	0x00, 0x00, 0x00, 0x00, 0x00, 0x00, 0x00, 0x00, 0x00, 0x00, 0x00, 0x00, 0x00, 0x00, 0x00, 0x00, 
	0x00, 0x00, 0x00, 0x00, 0x00, 0x00, 0x00, 0x00, 0x00, 0x00, 0x00, 0x00, 0x00, 0x00, 0x00, 0x00, 
	0x00, 0x00, 0x00, 0x00, 0x00, 0x00, 0x00, 0x00, 0x00, 0x00, 0x00, 0x00, 0x00, 0x00, 0x00, 0x00, 
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	0x00, 0x00, 0x00, 0x00, 0x00, 0x00, 0x00, 0x00
};
const unsigned char LOCK [] PROGMEM ={
	0x00, 0x00, 0x00, 0x00, 0x00, 0x00, 0x00, 0x00, 0x00, 0x00, 0x00, 0x00, 0x00, 0x00, 0x00, 0x00, 
	0x00, 0x00, 0x00, 0x00, 0x00, 0x00, 0x00, 0x00, 0x00, 0x00, 0x00, 0x00, 0x00, 0x00, 0x00, 0x00, 
	0x00, 0x00, 0x00, 0x00, 0x00, 0x00, 0x00, 0x00, 0x00, 0x00, 0x00, 0x00, 0x00, 0x00, 0x00, 0x00, 
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	0x00, 0x00, 0x00, 0x00, 0x00, 0x00, 0x00, 0x00
};
const unsigned char GAS[] PROGMEM ={
	0x00, 0x00, 0x00, 0x00, 0x00, 0x00, 0x00, 0x00, 0x00, 0x00, 0x00, 0x00, 0x00, 0x00, 0x00, 0x00, 
	0x00, 0x00, 0x00, 0x00, 0x00, 0x00, 0x00, 0x1f, 0xff, 0xf8, 0x00, 0x00, 0x00, 0x00, 0x1f, 0xff, 
	0xf8, 0x00, 0x00, 0x00, 0x00, 0x04, 0x3c, 0x20, 0x00, 0x00, 0x00, 0x00, 0x04, 0x1c, 0x20, 0x00, 
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	0x00, 0x00, 0x00, 0x00, 0x00, 0x00, 0x00, 0x00
};

//FUNCTION CALLS
void OLED_TEXT(char* text, int x, int y , int text_size);
void OLED_DRAW(const unsigned char* bitmap , int width , int height, int x , int y);
bool gas_sensor();
bool security();
bool gas_level_sensor();
float get_pressure();


void setup() {
  // put your setup code here, to run once:
  Serial.begin(9600);
  //PRESSURE SENSOR
  ps.initialize(PD_SCK , DOUT);
  atm_pressure  = get_pressure();
  delay(100);
  if(!display.begin(SSD1306_SWITCHCAPVCC, SCREEN_ADDRESS))
  {
    Serial.println("Failed!");
  }
  display.clearDisplay();
  connect_Wifi(true, "TEST");
  while (analogRead(GAS_SENSOR) > 20)
  {
    digitalWrite(2,HIGH);
  }
  delay(1000);
}

void loop() {
  // put your main code here, to run repeatedly:
  if(security())
  {
      display.clearDisplay();
      OLED_DRAW(LOCK , 56,56,0,10);
      OLED_TEXT("MVMT" , 60,30,2);
      display.display();
      connect_Wifi(false , "MOVEMENT DETECTED: CHECK YOUR LPG GAS");
  }
  else if (gas_level_sensor())
  {
      display.clearDisplay();
      OLED_DRAW(GAS, 56,56,0, 10);
      OLED_TEXT("LOW!" , 60,30,2);
      display.display();
      char message[50];
      snprintf(message , sizeof(message) , "GAS LEVEL GETTING LOW: %.2f Pa" ,get_pressure()-atm_pressure);
      connect_Wifi(false ,message);
  }
  else if (gas_sensor())
  {
      display.clearDisplay();
      OLED_DRAW(LEAK , 56,56,0,10);
      OLED_TEXT("LEAK" , 60,30,2);
      display.display();
      connect_Wifi(false , "GAS LEAK DETECTED");    
  }
  else
  {
    display.clearDisplay();
    OLED_DRAW(METER , 56,56,0,10);
    OLED_NUMBER(get_pressure()-atm_pressure,60,30,2);
    display.display();
  }
}


//..........................................WIFI CONNECTION
void connect_Wifi(bool connect , char* message)
{
  if(connect)
  {
    WiFi.begin(ssid,pass);
    while(WiFi.status() != WL_CONNECTED)
    {
      OLED_TEXT("WIFI TEST:", 0, 10,2);
      OLED_TEXT(ssid , 20,50,1);
      OLED_TEXT(pass , 50,50,1);
    }
    delay(500);
    display.clearDisplay();
    OLED_TEXT("CONNECTED" , 15,10,2);
    WiFi.disconnect();
  }
  else
  {
    WiFi.begin(ssid,pass);
    while(WiFi.status() != WL_CONNECTED)
    {
      Serial.print("...");
    }
    makeTwilioMessage(message);
    makeTwilioAPICall();
    delay(1000);
    WiFi.disconnect();
  }
}

//................................SCREEN FUNCTION CALLS
void OLED_TEXT(const char* text, int x, int y , int text_size)
{
  display.setTextSize(text_size);
  display.setTextColor(SSD1306_WHITE);
  display.setCursor(x,y);
  display.println(text);
  display.display();
}
void OLED_DRAW(const unsigned char* bitmap , int width , int height, int x , int y)
{
  display.drawBitmap(x,y , bitmap, width, height, SSD1306_WHITE);
  display.display();
}
void OLED_NUMBER(float num , int x , int y , int text_size )
{
  display.setTextSize(text_size);
  display.setTextColor(SSD1306_WHITE);
  display.setCursor(x,y);
  display.println(num);
  display.display();
}
//.............................GAS LEVEL READING
bool gas_level_sensor()
{
  float gas_level  = get_pressure() - atm_pressure;
  Serial.println(gas_level);
  
  if(gas_level < LOW_PRESSURE_THRESHOLD)
  {
    return true;
  }
  else
  {
    return false;
  }
}
//............................SECURITY FUNCTION CALLS
bool security()
{     
    for(int x = 0 ; x < 50 ; x++)
    {
      int i  = digitalRead(VIBRATION_SENSOR);
      if(!i)
      {
        return true;
        break;
      }
    }
    return false;
}
//............................GAS FUNCTION CALLS
float get_pressure()
{
   while(!ps.isReady());
   ps.readAndSelectNextData(HX710_DIFFERENTIAL_INPUT_40HZ);
   float gas_level = ps.getLastDifferentialInput()/10000;
   Serial.println(gas_level);
   return gas_level;
}
bool gas_sensor()
{
  int gas_leak = analogRead(GAS_SENSOR);//gas leak detection
  if(gas_leak > 700)
  {
    return true;
  }
  else
  {
    return false;
  }
}
//..............................COMMUNICATION PROTOCOL
void makeTwilioMessage(char* message)
{
  HTTPClient http;
  WiFiClientSecure client;
  client.setInsecure();
  String url = "https://api.twilio.com/2010-04-01/Accounts/";
  url += twilioAccountSID;
  url += "/Messages.json";

  http.begin(client , url.c_str());
  http.setAuthorization(twilioAccountSID, twilioAuthToken);
  http.addHeader("Content-Type", "application/x-www-form-urlencoded");
  String postData = "Body="+ String(message);//"Body=Mesage from esp32";
  postData += "&From=+12029333581";//"&From=+16164322533";
  postData += "&To=+254746537900";//"&To=+254757283005";

  int httpResponseCode = http.POST(postData);
  Serial.println(postData);
  Serial.print("HTTP Response Code: ");
  Serial.println(httpResponseCode);

  String response = http.getString();
  Serial.println("Server response: "+ response);
  
  http.end();
  delay(5000);

}

void makeTwilioAPICall()
{
  String url = "https://api.twilio.com/2010-04-01/Accounts/" + String(twilioAccountSID) + "/Calls.json";
  String payload = "Url=http://demo.twilio.com/docs/voice.xml";
  payload +="&To=+254746537900";//"&To=+254757283005";
  payload +="&From=+12029333581";//"&From=+16164322533";

  HTTPClient http;
  WiFiClientSecure client;

  client.setInsecure();
  http.begin(client , url.c_str()); 
  http.addHeader("Content-Type", "application/x-www-form-urlencoded");

  String auth = twilioAccountSID;
  auth.concat(":");
  auth.concat(twilioAuthToken);// + ":" + twilioAuthToken;
  String encodedAuth = base64::encode(auth);
  http.addHeader("Authorization", "Basic " + encodedAuth);

  int httpCode = http.POST(payload);
  if (httpCode > 0 )
  {
    Serial.printf("[HTTP] POST request done, HTTP code: %d\n", httpCode);
    Serial.println(http.getString());   
  }
  else 
  {
    Serial.printf("[HTTP] POST request failed, HTTP error code: %d\n", httpCode);
  }
  Serial.println();
  Serial.println(http.getString());
  http.end();
}
